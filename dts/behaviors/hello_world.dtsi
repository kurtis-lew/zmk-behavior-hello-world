/*
 * Copyright (c) XXXX The ZMK Contributors
 *
 * SPDX-License-Identifier: MIT
 */

#include <dt-bindings/zmk/behaviors.h>

/ {
    behaviors {
#if ZMK_BEHAVIOR_OMIT(HELLO_WORLD)
        /omit-if-no-ref/
#endif
        hello_world: hello_world {
            compatible = "zmk,behavior-hello-world";
            #binding-cells = <0>;
            display-name = "Hello World";
        };
    };
};
